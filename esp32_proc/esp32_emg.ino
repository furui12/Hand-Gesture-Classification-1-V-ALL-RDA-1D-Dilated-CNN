#include <math.h>
#include <TensorFlowLite_ESP32.h>
#include "tensorflow/lite/micro/all_ops_resolver.h"
#include "tensorflow/lite/micro/micro_error_reporter.h"
#include "tensorflow/lite/micro/micro_interpreter.h"
#include "tensorflow/lite/schema/schema_generated.h"

// Include both model headers
#include "gesture_rda_model.h"        // Model 1 (RDA)
#include "emg_gesture_dilated_cnn.h"  // Model 2 (1D Dilated CNN)

// MyoWare 2.0 Sensor Pins (Analog ADC Pins)
// Connect MyoWare SIG to these pins. GND to GND, and + to 3V3.
const int MYOWARE_CH1_PIN = 1; // GPIO 1 (A0 on XIAO ESP32-S3)
const int MYOWARE_CH2_PIN = 2; // GPIO 2 (A1 on XIAO ESP32-S3)

//THUMB AND INDEX ARE REVERSED!!!
// Define servo pins
const int numServos = 6;
const int servoPins[numServos] = {6, 43, 44, 7, 8, 9};
const int ledcChannels[numServos] = {0, 1, 2, 3, 4, 5};

// Servo parameters for standard MG955
const int freq = 50;           // 50Hz frequency standard for servos
const int resolution = 14;     // 14-bit resolution gives us a range of 0 to 16383

// 14-bit calculation for standard 50Hz (20ms total period):
// 1ms pulse (0 degrees)   = (1ms / 20ms) * 16383 = ~819 --> ~410 for 0.5 ms of min pulse width
// 2ms pulse (180 degrees) = (2ms / 20ms) * 16383 = ~1638 --> ~2048 for 2.5 ms of max pulse width
const int minDuty = 450;  
const int maxDuty = 2000; 

// --- TFLite Globals for Model 1 (RDA) ---
constexpr int kTensorArenaSizeRDA = 4 * 1024;
uint8_t tensor_arena_rda[kTensorArenaSizeRDA];
const tflite::Model* model_rda = nullptr;
tflite::MicroInterpreter* interpreter_rda = nullptr;
TfLiteTensor* input_rda = nullptr;
TfLiteTensor* output_rda = nullptr;

// --- TFLite Globals for Model 2 (CNN) ---
// constexpr int kTensorArenaSizeCNN = 128 * 1024;
constexpr int kTensorArenaSizeCNN = 128 * 1024;
EXT_RAM_ATTR uint8_t tensor_arena_cnn[kTensorArenaSizeCNN];
const tflite::Model* model_cnn = nullptr;
tflite::MicroInterpreter* interpreter_cnn = nullptr;
TfLiteTensor* input_cnn = nullptr;
TfLiteTensor* output_cnn = nullptr;

tflite::ErrorReporter* error_reporter = nullptr;

// --- Data Placeholders ---
const int NUM_WINDOWS = 20; // (For Independent Testing and Troubleshooting)
const int SAMPLES_PER_WINDOW = 200; // 200ms at 1000Hz
const float sample_windows[NUM_WINDOWS][2][SAMPLES_PER_WINDOW] = {};
const float emg_data[2][SAMPLES_PER_WINDOW]; // (For Actual EMG Data Stream)

// --- CNN Normalization & Quantization Parameters ---
const int NUM_FEATURES = 20;
// REPLACE ALL GLOBAL VARIABLES BELOW WITH VALUES GENERATED BY PYTHON SCRIPT!!
const float SCALER_MEAN[20];
const float SCALER_SCALE[20];
const float INPUT_SCALE;
const int8_t INPUT_ZERO_POINT;
const float OUTPUT_SCALE;
const int8_t OUTPUT_ZERO_POINT;

//  --- Signal Preprocessing ---
void preprocess_emg_signals(float* ch1, float* ch2, int n) {
}

// --- Feature Extraction Math ---

float calculate_rms(const float* x, int n) {
    float sum_sq = 0.0f;
    for (int i = 0; i < n; i++) sum_sq += x[i] * x[i];
    return sqrt(sum_sq / n);
}

float calculate_wamp(const float* x, int n, float threshold = 0.01f) {
    float count = 0.0f;
    for (int i = 1; i < n; i++) {
        if (fabs(x[i] - x[i - 1]) > threshold) count += 1.0f;
    }
    return count;
}

float calculate_log_var(const float* x, int n) {
    float mean = 0.0f;
    for (int i = 0; i < n; i++) mean += x[i];
    mean /= n;
    float sum_sq_diff = 0.0f;
    for (int i = 0; i < n; i++) {
        float diff = x[i] - mean;
        sum_sq_diff += diff * diff;
    }
    return log((sum_sq_diff / n) + 1e-8f);
}

void calculate_ar_coeffs(const float* x, int n, int order, float* ar_out) {
    float r[5] = {0};
    for (int i = 0; i <= order; i++) {
        for (int j = 0; j < n - i; j++) r[i] += x[j] * x[j + i];
    }
    if (r[0] == 0.0f) {
        for (int i = 0; i < order; i++) ar_out[i] = 0.0f;
        return;
    }
    float a[5][5] = {0}, e[5] = {0};
    e[0] = r[0];
    for (int i = 1; i <= order; i++) {
        float sum = 0.0f;
        for (int j = 1; j < i; j++) sum += a[i - 1][j] * r[i - j];
        float k = (r[i] - sum) / e[i - 1];
        a[i][i] = k;
        for (int j = 1; j < i; j++) a[i][j] = a[i - 1][j] - k * a[i - 1][i - j];
        e[i] = (1.0f - k * k) * e[i - 1];
    }
    for (int i = 1; i <= order; i++) ar_out[i - 1] = -a[order][i];
}

// CNN Specific Features
float calculate_mav(const float* x, int n) {
    float sum = 0.0f;
    for (int i = 0; i < n; i++) sum += fabs(x[i]);
    return sum / n;
}

float calculate_wl(const float* x, int n) {
    float sum = 0.0f;
    for (int i = 1; i < n; i++) sum += fabs(x[i] - x[i - 1]);
    return sum;
}

float calculate_zc(const float* x, int n, float threshold = 0.01f) {
    float count = 0.0f;
    for (int i = 1; i < n; i++) {
        float sign_prev = (x[i-1] > 0) - (x[i-1] < 0);
        float sign_curr = (x[i] > 0) - (x[i] < 0);
        if (sign_curr != sign_prev && fabs(x[i] - x[i-1]) > threshold) count += 1.0f;
    }
    return count;
}

float calculate_ssc(const float* x, int n, float threshold = 0.01f) {
    float count = 0.0f;
    for (int i = 2; i < n; i++) {
        float diff1 = x[i-1] - x[i-2];
        float diff2 = x[i] - x[i-1];
        if ((diff1 * diff2 < 0) && (fabs(diff1) > threshold) && (fabs(diff2) > threshold)) count += 1.0f;
    }
    return count;
}

// --- Model 2 (CNN) Feature Extraction Math ---

void extract_single_channel_cnn_features(const float* ch, int n, float* out) {
    float sum_x = 0, sum_x2 = 0;
    float sum_dx = 0, sum_dx2 = 0;
    float sum_d2x2 = 0;
    float wl = 0, wl_dx = 0;
    float sum_tkeo = 0;

    for (int i = 0; i < n; i++) {
        float xi = ch[i];
        sum_x += xi;
        sum_x2 += xi * xi;

        if (i > 0) {
            float dx = xi - ch[i-1];
            sum_dx += fabs(dx);
            sum_dx2 += dx * dx;
            wl += fabs(dx);
            if (i > 1) {
                float d2x = dx - (ch[i-1] - ch[i-2]);
                sum_d2x2 += d2x * d2x;
                wl_dx += fabs(d2x);

                // Teager-Kaiser Energy Operator
                float tkeo = ch[i-1]*ch[i-1] - ch[i]*ch[i-2];
                sum_tkeo += tkeo;
            }
        }
    }

    float mean_x = sum_x / n;
    float var_x = (sum_x2 / n) - (mean_x * mean_x);
    if (var_x < 1e-8f) var_x = 1e-8f;
    float std_x = sqrt(var_x);

    // Moments
    float m0 = sum_x2 / n;
    float m2 = sum_dx2 / (n - 1);
    float m4 = sum_d2x2 / (n - 2);

    // 1-3. Root Squared Moments
    out[0] = sqrt(m0);
    out[1] = sqrt(m2);
    out[2] = sqrt(m4);

    // Normalized Moments (Skewness & Kurtosis to fulfill 10-feature array)
    float skew = 0, kurt = 0;
    for (int i = 0; i < n; i++) {
        float diff = (ch[i] - mean_x) / std_x;
        skew += diff * diff * diff;
        kurt += diff * diff * diff * diff;
    }
    // 4-5. Normalized Moments
    out[3] = skew / n;
    out[4] = kurt / n;

    // 6. Sparseness
    out[5] = m0 / (sqrt(m0 * m4) + 1e-8f);

    // 7. Irregularity Factor
    out[6] = m2 / (sqrt(m0 * m4) + 1e-8f);

    // 8. Waveform Length Ratio
    out[7] = wl / (wl_dx + 1e-8f);

    // 9. Coefficient of Variation
    out[8] = std_x / (fabs(mean_x) + 1e-8f);

    // 10. Teager-Kaiser Energy Operator (Mean TKEO)
    out[9] = sum_tkeo / (n - 2);
}

// --- Extractor Wrappers ---

void extract_rda_features(const float* ch1, const float* ch2, int n, float* out_features) {
    // 14 Features (RMS, WAMP, Log-Var, AR4 per channel)
    out_features[0] = calculate_rms(ch1, n);
    out_features[1] = calculate_wamp(ch1, n);
    out_features[2] = calculate_log_var(ch1, n);
    calculate_ar_coeffs(ch1, n, 4, &out_features[3]);

    out_features[7] = calculate_rms(ch2, n);
    out_features[8] = calculate_wamp(ch2, n);
    out_features[9] = calculate_log_var(ch2, n);
    calculate_ar_coeffs(ch2, n, 4, &out_features[10]);
}

// void extract_cnn_features(const float* ch1, const float* ch2, int n, float* out_features) {
//     // 22 Features (MAV, WL, RMS, ZC, SSC, WAMP, Log-Var, AR4 per channel)
//     // Channel 1
//     out_features[0] = calculate_mav(ch1, n);
//     out_features[1] = calculate_wl(ch1, n);
//     out_features[2] = calculate_rms(ch1, n);
//     out_features[3] = calculate_zc(ch1, n);
//     out_features[4] = calculate_ssc(ch1, n);
//     out_features[5] = calculate_wamp(ch1, n);
//     out_features[6] = calculate_log_var(ch1, n);
//     calculate_ar_coeffs(ch1, n, 4, &out_features[7]);

//     // Channel 2
//     out_features[11] = calculate_mav(ch2, n);
//     out_features[12] = calculate_wl(ch2, n);
//     out_features[13] = calculate_rms(ch2, n);
//     out_features[14] = calculate_zc(ch2, n);
//     out_features[15] = calculate_ssc(ch2, n);
//     out_features[16] = calculate_wamp(ch2, n);
//     out_features[17] = calculate_log_var(ch2, n);
//     calculate_ar_coeffs(ch2, n, 4, &out_features[18]);
// }

void extract_cnn_features(const float* ch1, const float* ch2, int n, float* out_features) {
    // Channel 1 fills indices 0-9
    extract_single_channel_cnn_features(ch1, n, &out_features[0]);
    // Channel 2 fills indices 10-19
    extract_single_channel_cnn_features(ch2, n, &out_features[10]);
}

// --- Arduino Setup & Loop ---

void setup() {
    Serial.begin(115200);
    while (!Serial);

    // Initialize dummy data
    // COMMENT OUT WHEN YOU HAVE REAL DATA OR DATA STREAM FROM EMG SENSORS!!!
    for (int w = 0; w < NUM_WINDOWS; w++) {
        for (int ch = 0; ch < 2; ch++) {
            for (int s = 0; s < SAMPLES_PER_WINDOW; s++) {
                sample_windows[w][ch][s] = ((float)rand() / RAND_MAX) * 0.05f;
            }
        }
    }

    static tflite::MicroErrorReporter micro_error_reporter;
    error_reporter = &micro_error_reporter;
    static tflite::AllOpsResolver resolver;

    // --- SETUP MODEL 1 (RDA) ---
    model_rda = tflite::GetModel(gesture_rda_model_tflite);
    static tflite::MicroInterpreter static_interpreter_rda(
        model_rda, resolver, tensor_arena_rda, kTensorArenaSizeRDA, error_reporter);
    interpreter_rda = &static_interpreter_rda;
    interpreter_rda->AllocateTensors();
    input_rda = interpreter_rda->input(0);
    output_rda = interpreter_rda->output(0);

    // --- SETUP MODEL 2 (CNN) ---
    model_cnn = tflite::GetModel(emg_gesture_dilated_cnn_tflite);
    static tflite::MicroInterpreter static_interpreter_cnn(
        model_cnn, resolver, tensor_arena_cnn, kTensorArenaSizeCNN, error_reporter);
    interpreter_cnn = &static_interpreter_cnn;
    interpreter_cnn->AllocateTensors();
    input_cnn = interpreter_cnn->input(0);
    output_cnn = interpreter_cnn->output(0);

    Serial.println("Dual-Model setup complete. Starting inference loop...");

    // Initialize each pin on its own independent hardware channel
    for (int i = 0; i < numServos; i++) {
        ledcSetup(ledcChannels[i], freq, resolution);
        ledcAttachPin(servoPins[i], ledcChannels[i]);
        // Initialize all motors to 90 degrees (mid-point)
        // writeServoAngle(i, 90);
    }
}

void loop() {
    restGesture();
    float rda_features[14];
    // float cnn_features[22];
    float cnn_features[20];

    // REPLACE OPTIMIZED THRESHOLD VALUES GENERATED BY PYTHON SCRIPTS!!!
    const float thresholds[4] = {0.9950f, 0.9950f, 0.9950f, 0.9950f};

    // UNCOMMENT WHEN YOU SET UP EMG SENSORS!!!
//     unsigned long nextSampleTime = micros();
//
//     for (int i = 0; i < SAMPLES_PER_WINDOW; i++) {
//         emg_data[0][i] = analogRead(MYOWARE_CH1_PIN);
//         emg_data[1][i] = analogRead(MYOWARE_CH2_PIN);
//
//         nextSampleTime += 1000; // 1000 microseconds = 1 millisecond
//         while (micros() < nextSampleTime) {
//             // Tight loop to enforce exact 1000Hz sampling
//             // Using a blocking wait here is safe because this request runs on Core 1
//             // while the background WiFi stack runs on Core 0.
//         }
//     }
//     // --- STEP 0: Preprocess EMG Data ---
//     preprocess_emg_signals(emg_data[0], emg_data[1], SAMPLES_PER_WINDOW);
//
//     // --- STEP 1: RDA Inference ---
//     extract_rda_features(emg_data[0], emg_data[1], SAMPLES_PER_WINDOW, rda_features);
//
//     for (int i = 0; i < 14; i++) {
//         input_rda->data.f[i] = rda_features[i];
//     }
//     interpreter_rda->Invoke();
//
//     // Normalize RDA Posterior Probabilities
//     float sum_probs = 0.0f;
//     for (int i = 0; i < 4; i++) sum_probs += output_rda->data.f[i];
//
//     float rda_max_prob = -1.0f;
//     int rda_best_class = -1;
//
//     //Serial.println("Model 1 (RDA) Probabilities:");
//     for (int i = 0; i < 4; i++) {
//         float prob = sum_probs > 0.0f ? (output_rda->data.f[i] / sum_probs) : 0.0f;
//         Serial.printf("  Class %d: %.4f\n", i, prob);
//         if (prob > rda_max_prob) {
//             rda_max_prob = prob;
//             rda_best_class = i;
//         }
//     }
//
//     int final_prediction = -1;
//
//     // --- STEP 2: Confidence Evaluation & CNN Fallback ---
//     float required_threshold = thresholds[rda_best_class];
//
//     if (rda_max_prob >= required_threshold) {
//         // High confidence. Accept immediately.
//         final_prediction = rda_best_class;
//         //Serial.println("-> RDA Confident. Prediction ACCEPTED.");
//     }
//     else {
//         // RDA is unsure. Calculate margin of failure.
//         // (Using absolute difference. e.g., 0.995 - 0.850 = 0.145 diff)
//         float margin = required_threshold - rda_max_prob;
//
//         //Serial.printf("-> RDA Rejected (Fell short by %.4f). ", margin);
//
//         if (margin <= 0.15f) {
//             Serial.println("Within 15% margin. Waking up Model 2 (CNN)...");
//
//             // Extract the 22 features required for the CNN
//             extract_cnn_features(emg_data[0], emg_data[1], SAMPLES_PER_WINDOW, cnn_features);
//
//             for (int i = 0; i < NUM_FEATURES; i++) {
//                 // 1. Apply Scikit-Learn StandardScaler
//                 float standardized_val = (cnn_features[i] - SCALER_MEAN[i]) / SCALER_SCALE[i];
//
//                 // 2. Quantize for TFLite Micro
//                 int32_t quantized_val = round(standardized_val / INPUT_SCALE) + INPUT_ZERO_POINT;
//
//                 // 3. Clamp to INT8 bounds
//                 if (quantized_val > 127) quantized_val = 127;
//                 if (quantized_val < -128) quantized_val = -128;
//
//                 input_cnn->data.int8[i] = (int8_t)quantized_val;
//             }
//
//             interpreter_cnn->Invoke();
//
//             int8_t cnn_max_score = -128;
//             int cnn_best_class = -1;
//             int8_t a_priori_score = -50;
//
//             Serial.println("Model 2 (CNN) Quantized Scores:");
//             for (int i = 0; i < 4; i++) {
//                 int8_t score = output_cnn->data.int8[i];
//                 Serial.printf("  Class %d: %d\n", i, score);
//                 if (score > cnn_max_score) {
//                     cnn_max_score = score;
//                     cnn_best_class = i;
//                 }
//             }
//
//             if (cnn_best_class == rda_best_class) {
//                 Serial.println("-> CNN agrees with RDA's initial hunch. Prediction ACCEPTED.");
//                 final_prediction = cnn_best_class;
//             } else {
//                 Serial.println("-> CNN disagrees (Predictions are far apart). Output remains REJECTED.");
//             }
//
//         } else {
//             //Serial.println("Margin > 15%. Too uncertain to trigger CNN. Output remains REJECTED.");
//         }
//     }
//
//     switch (final_prediction) {
//         case 0:
//             cylindricalWrap();
//             break;
//         case 1:
//             keyPinch();
//             break;
//         case 2:
//             pulpPinch();
//             break;
//         case 3:
//             tripodPinch();
//             break;
//         case 4:
//             restGesture();
//             break;
//         default:
//             break;
//     }

    for (int w = 0; w < NUM_WINDOWS; w++) {
        Serial.printf("\n=== Processing Window %d ===\n", w + 1);

        // --- STEP 1: RDA Inference ---
        extract_rda_features(sample_windows[w][0], sample_windows[w][1], SAMPLES_PER_WINDOW, rda_features);

        for (int i = 0; i < 14; i++) {
            input_rda->data.f[i] = rda_features[i];
        }
        interpreter_rda->Invoke();

        // Normalize RDA Posterior Probabilities
        float sum_probs = 0.0f;
        for (int i = 0; i < 4; i++) sum_probs += output_rda->data.f[i];

        float rda_max_prob = -1.0f;
        int rda_best_class = -1;

        //Serial.println("Model 1 (RDA) Probabilities:");
        for (int i = 0; i < 4; i++) {
            float prob = sum_probs > 0.0f ? (output_rda->data.f[i] / sum_probs) : 0.0f;
            Serial.printf("  Class %d: %.4f\n", i, prob);
            if (prob > rda_max_prob) {
                rda_max_prob = prob;
                rda_best_class = i;
            }
        }

        int final_prediction = -1;

        // --- STEP 2: Confidence Evaluation & CNN Fallback ---
        float required_threshold = thresholds[rda_best_class];

        if (rda_max_prob >= required_threshold) {
            // High confidence. Accept immediately.
            final_prediction = rda_best_class;
            //Serial.println("-> RDA Confident. Prediction ACCEPTED.");
        }
        else {
            // RDA is unsure. Calculate margin of failure.
            // (Using absolute difference. e.g., 0.995 - 0.850 = 0.145 diff)
            float margin = required_threshold - rda_max_prob;

            //Serial.printf("-> RDA Rejected (Fell short by %.4f). ", margin);

            if (margin <= 0.15f) {
                Serial.println("Within 15% margin. Waking up Model 2 (CNN)...");

                // Extract the 22 features required for the CNN
                extract_cnn_features(sample_windows[w][0], sample_windows[w][1], SAMPLES_PER_WINDOW, cnn_features);

                // CNN input tensor is back to INT8.
                // for (int i = 0; i < 22; i++) {
                //     // Quantization formula: q = round(f / scale) + zero_point
                //     int32_t quantized_val = round(cnn_features[i] / cnn_input_scale) + cnn_input_zero_point;
                //     // input_cnn->data.f[i] = cnn_features[i];

                //     // OLD: Clamp values to INT8 range bounds
                //     if (quantized_val > 127) quantized_val = 127;
                //     if (quantized_val < -128) quantized_val = -128;

                //     input_cnn->data.int8[i] = (int8_t)quantized_val;
                // }
                for (int i = 0; i < NUM_FEATURES; i++) {
                    // 1. Apply Scikit-Learn StandardScaler
                    float standardized_val = (cnn_features[i] - SCALER_MEAN[i]) / SCALER_SCALE[i];

                    // 2. Quantize for TFLite Micro
                    int32_t quantized_val = round(standardized_val / INPUT_SCALE) + INPUT_ZERO_POINT;

                    // 3. Clamp to INT8 bounds
                    if (quantized_val > 127) quantized_val = 127;
                    if (quantized_val < -128) quantized_val = -128;

                    input_cnn->data.int8[i] = (int8_t)quantized_val;
                }

                interpreter_cnn->Invoke();
                // --- FLOAT32 CNN Output ---
                // We directly read the probabilities from the output tensor
                // float cnn_max_prob = -1.0f;
                // int cnn_best_class = -1;

                // Find highest class score directly from INT8 output tensor
                int8_t cnn_max_score = -128;
                int cnn_best_class = -1;
                int8_t a_priori_score = -50;

                Serial.println("Model 2 (CNN) Quantized Scores:");
                for (int i = 0; i < 4; i++) {
                    int8_t score = output_cnn->data.int8[i];
                    Serial.printf("  Class %d: %d\n", i, score);
                    if (score > cnn_max_score) {
                        cnn_max_score = score;
                        cnn_best_class = i;
                    }
                }
                // Serial.println("Model 2 (CNN) Quantized Scores:");
                // for (int i = 0; i < 4; i++) {
                //     int8_t score = output_cnn->data.int8[i];
                //     Serial.printf("  Class %d: %d\n", i, score);
                //     if (score > a_priori_score && i == rda_best_class) {
                //         cnn_best_class = i;
                //     }
                // }
                // Serial.println("Model 2 (CNN) Class Prediction");
                // for (int i = 0; i < 4; i++) {
                //     int8_t score = output_cnn->data.int8[i];
                //     if (score == cnn_max_score && i == rda_best_class) {
                //         cnn_best_class = i;
                //     }
                // }
                // Serial.println("Model 2 (CNN) Probabilities:");
                // for (int i = 0; i < 5; i++) {
                //     float prob = output_cnn->data.f[i];
                //     // Serial.printf("  Class %d: %.4f\n", i, prob);
                //     if (prob > cnn_max_prob) {
                //         cnn_max_prob = prob;
                //         cnn_best_class = i;
                //     }
                // }

                // Check for consensus
                if (cnn_best_class == rda_best_class) {
                    Serial.println("-> CNN agrees with RDA's initial hunch. Prediction ACCEPTED.");
                    final_prediction = cnn_best_class;
                } else {
                    Serial.println("-> CNN disagrees (Predictions are far apart). Output remains REJECTED.");
                }

            } else {
                //Serial.println("Margin > 15%. Too uncertain to trigger CNN. Output remains REJECTED.");
            }
        }

        delay(2000);

        switch (final_prediction) {
            case 0:
                cylindricalWrap();
                break;
            case 1:
                keyPinch();
                break;
            case 2:
                pulpPinch();
                break;
            case 3:
                tripodPinch();
                break;
            case 4:
                restGesture();
                break;
            default:
                break;
        }

        delay(2000);
        restGesture();
    }

    // Serial.println("\nDemonstration complete. Halting.");
    // while(true){ delay(1000); }
}

void defaultHand() {
    writeServoAngle(0, 90);
    writeServoAngle(1, 90);
    writeServoAngle(2, 90);
    writeServoAngle(3, 90);
    writeServoAngle(4, 90);
    // writeServoAngle(5, 90);
}

void restGesture() {
    writeServoAngle(0, 60);
    writeServoAngle(1, 60);
    writeServoAngle(2, 110);
    writeServoAngle(3, 110);
    writeServoAngle(4, 110);
    // writeServoAngle(5, 90);
    delay(750);
    writeServoAngle(0, 70);
    writeServoAngle(1, 70);
    writeServoAngle(2, 100);
    writeServoAngle(3, 100);
    writeServoAngle(4, 100);
}

void cylindricalWrap() {
    writeServoAngle(0, 150);
    writeServoAngle(1, 150);
    writeServoAngle(2, 30);
    writeServoAngle(3, 30);
    writeServoAngle(4, 30);
    // writeServoAngle(5, 90);
}

void keyPinch() {
    writeServoAngle(0, 175);
    writeServoAngle(1, 180);
    writeServoAngle(2, 0);
    writeServoAngle(3, 0);
    writeServoAngle(4, 0);
    // writeServoAngle(5, 90);
}

void pulpPinch() {
    writeServoAngle(0, 175);
    writeServoAngle(1, 180);
    writeServoAngle(2, 100);
    writeServoAngle(3, 100);
    writeServoAngle(4, 100);
    // writeServoAngle(5, 0);
}

void tripodPinch() {
    writeServoAngle(0, 175);
    writeServoAngle(1, 180);
    writeServoAngle(2, 0);
    writeServoAngle(3, 100);
    writeServoAngle(4, 100);
    // writeServoAngle(5, 0);
}

// Custom function to handle writing standard angles (0 to 180)
void writeServoAngle(int servoIndex, int angle) {
    // Constrain angle to prevent mechanical strain
    angle = constrain(angle, 0, 180);
    
    // Map 0-180 degrees to the 14-bit duty cycle values
    int duty = map(angle, 0, 180, minDuty, maxDuty);
    
    // Write directly to the hardware channel
    ledcWrite(ledcChannels[servoIndex], duty);
}
